/include/ "system-conf.dtsi"
/include/ "port-config.dtsi"
/ {
};

/* Ethernet wiring (FMC ports 0-2 = PL AXI Ethernet, FMC port 3 = PS GEM1,
 * board RJ45 = PS GEM0, their PHYs and MACs) comes from port-config.dtsi
 * (ports-0123-axieth overlay, included above); GEM0 and GEM1 must stay
 * enabled. The overlay gives gem0 a phy-handle and an MDIO child, so 2025.01
 * u-boot no longer data-aborts probing it (that crash needs a gem0 without a
 * PHY description). This dtb is also u-boot's control DT (BOOT.BIN loads it
 * at 0x100000).
 * board RJ45 = PS GEM0 on MIO16-27, Marvell 88E1518 at MDIO address 0,
 * rgmii-id, as the overlay describes it (same as the Yocto build). */
