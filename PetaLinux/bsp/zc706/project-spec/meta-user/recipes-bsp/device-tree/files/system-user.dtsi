/include/ "system-conf.dtsi"
/include/ "port-config.dtsi"
/ {
};

/* Ethernet wiring (FMC ports 0-2 = PL AXI Ethernet, FMC port 3 = PS GEM1,
 * board RJ45 = PS GEM0, their PHYs and MACs) comes from port-config.dtsi
 * (ports-0123-axieth overlay, included above); GEM0 and GEM1 must stay
 * enabled. The overlay gives gem0 a phy-handle and an MDIO child, so 2025.01
 * u-boot no longer data-aborts probing it (that crash needs a gem0 without a
 * PHY description). This dtb is also u-boot's control DT (BOOT.BIN loads it
 * at 0x100000).
 * ZC706: the board RJ45 PHY (Marvell 88E1116R, upstream zynq-zc706.dts) is
 * at MDIO address 7, not at the overlay's address 0, so the overlay's gem0
 * PHY node is replaced here; phy-mode rgmii-id and the MAC stay as the
 * overlay sets them; the PHY reset (MIO47) comes from the generated DT. */
&gem0 {
    phy-handle = <&gem0_phy>;
    mdio {
        /delete-node/ phy@0;
        gem0_phy: phy@7 {
            device_type = "ethernet-phy";
            reg = <7>;
        };
    };
};
